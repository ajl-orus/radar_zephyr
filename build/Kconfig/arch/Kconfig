## build/Kconfig/arch/Kconfig
```kconfig
# Load Zephyr Arch Kconfig descriptions.
osource "/home/ajl/zephyrproject/zephyr/arch/rx/Kconfig"
osource "/home/ajl/zephyrproject/zephyr/arch/x86/Kconfig"
osource "/home/ajl/zephyrproject/zephyr/arch/xtensa/Kconfig"
osource "/home/ajl/zephyrproject/zephyr/arch/sparc/Kconfig"
osource "/home/ajl/zephyrproject/zephyr/arch/riscv/Kconfig"
osource "/home/ajl/zephyrproject/zephyr/arch/posix/Kconfig"
osource "/home/ajl/zephyrproject/zephyr/arch/mips/Kconfig"
osource "/home/ajl/zephyrproject/zephyr/arch/arm64/Kconfig"
osource "/home/ajl/zephyrproject/zephyr/arch/arm/Kconfig"
osource "/home/ajl/zephyrproject/zephyr/arch/arc/Kconfig"
```

## build/Kconfig/boards/Kconfig.defconfig
```kconfig
# Load Zephyr board defconfig descriptions.
osource "/home/ajl/zephyrproject/zephyr/boards/arm/mps2/Kconfig.defconfig"
```

## build/Kconfig/boards/Kconfig.mps2
```kconfig
# Load board Kconfig descriptions.
osource "/home/ajl/zephyrproject/zephyr/boards/arm/mps2/Kconfig.mps2"
```

## build/Kconfig/boards/Kconfig.sysbuild
```kconfig
# Load Sysbuild board Kconfig descriptions.
osource "/home/ajl/zephyrproject/zephyr/boards/arm/mps2/Kconfig.sysbuild"
```
